## package/thebluesystem-sdk/Config.in
```kconfig
config BR2_PACKAGE_THEBLUESYSTEM_SDK
	bool "SDK"
	depends on BR2_PACKAGE_XORG7
	depends on BR2_PACKAGE_THEBLUESYSTEM_USERSPACE
	help
	  The SDK for The Blue System.
```

## package/thebluesystem-userspace/Config.in
```kconfig
config BR2_PACKAGE_THEBLUESYSTEM_USERSPACE
	bool "Userspace"
	depends on BR2_PACKAGE_XORG7
	help
	  The userspace code for The Blue System.
```
